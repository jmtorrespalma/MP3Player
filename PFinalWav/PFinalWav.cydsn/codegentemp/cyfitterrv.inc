    IF :LNOT::DEF:INCLUDED_CYFITTERRV_INC
INCLUDED_CYFITTERRV_INC EQU 1
    GET cydevicerv.inc
    GET cydevicerv_trm.inc

; Clock
Clock__CFG0 EQU CYREG_CLKDIST_DCFG0_CFG0
Clock__CFG1 EQU CYREG_CLKDIST_DCFG0_CFG1
Clock__CFG2 EQU CYREG_CLKDIST_DCFG0_CFG2
Clock__CFG2_SRC_SEL_MASK EQU 0x07
Clock__INDEX EQU 0x00
Clock__PM_ACT_CFG EQU CYREG_PM_ACT_CFG2
Clock__PM_ACT_MSK EQU 0x01
Clock__PM_STBY_CFG EQU CYREG_PM_STBY_CFG2
Clock__PM_STBY_MSK EQU 0x01

; VDAC8_viDAC8
VDAC8_viDAC8__CR0 EQU CYREG_DAC0_CR0
VDAC8_viDAC8__CR1 EQU CYREG_DAC0_CR1
VDAC8_viDAC8__D EQU CYREG_DAC0_D
VDAC8_viDAC8__PM_ACT_CFG EQU CYREG_PM_ACT_CFG8
VDAC8_viDAC8__PM_ACT_MSK EQU 0x01
VDAC8_viDAC8__PM_STBY_CFG EQU CYREG_PM_STBY_CFG8
VDAC8_viDAC8__PM_STBY_MSK EQU 0x01
VDAC8_viDAC8__STROBE EQU CYREG_DAC0_STROBE
VDAC8_viDAC8__SW0 EQU CYREG_DAC0_SW0
VDAC8_viDAC8__SW2 EQU CYREG_DAC0_SW2
VDAC8_viDAC8__SW3 EQU CYREG_DAC0_SW3
VDAC8_viDAC8__SW4 EQU CYREG_DAC0_SW4
VDAC8_viDAC8__TR EQU CYREG_DAC0_TR
VDAC8_viDAC8__TRIM__M1 EQU CYREG_FLSHID_CUST_TABLES_DAC0_M1
VDAC8_viDAC8__TRIM__M2 EQU CYREG_FLSHID_CUST_TABLES_DAC0_M2
VDAC8_viDAC8__TRIM__M3 EQU CYREG_FLSHID_CUST_TABLES_DAC0_M3
VDAC8_viDAC8__TRIM__M4 EQU CYREG_FLSHID_CUST_TABLES_DAC0_M4
VDAC8_viDAC8__TRIM__M5 EQU CYREG_FLSHID_CUST_TABLES_DAC0_M5
VDAC8_viDAC8__TRIM__M6 EQU CYREG_FLSHID_CUST_TABLES_DAC0_M6
VDAC8_viDAC8__TRIM__M7 EQU CYREG_FLSHID_CUST_TABLES_DAC0_M7
VDAC8_viDAC8__TRIM__M8 EQU CYREG_FLSHID_CUST_TABLES_DAC0_M8
VDAC8_viDAC8__TST EQU CYREG_DAC0_TST

; isrWAV
isrWAV__INTC_CLR_EN_REG EQU CYREG_NVIC_CLRENA0
isrWAV__INTC_CLR_PD_REG EQU CYREG_NVIC_CLRPEND0
isrWAV__INTC_MASK EQU 0x01
isrWAV__INTC_NUMBER EQU 0
isrWAV__INTC_PRIOR_NUM EQU 7
isrWAV__INTC_PRIOR_REG EQU CYREG_NVIC_PRI_0
isrWAV__INTC_SET_EN_REG EQU CYREG_NVIC_SETENA0
isrWAV__INTC_SET_PD_REG EQU CYREG_NVIC_SETPEND0

; LCD_Char_LCDPort
LCD_Char_LCDPort__0__MASK EQU 0x01
LCD_Char_LCDPort__0__PC EQU CYREG_PRT2_PC0
LCD_Char_LCDPort__0__PORT EQU 2
LCD_Char_LCDPort__0__SHIFT EQU 0
LCD_Char_LCDPort__1__MASK EQU 0x02
LCD_Char_LCDPort__1__PC EQU CYREG_PRT2_PC1
LCD_Char_LCDPort__1__PORT EQU 2
LCD_Char_LCDPort__1__SHIFT EQU 1
LCD_Char_LCDPort__2__MASK EQU 0x04
LCD_Char_LCDPort__2__PC EQU CYREG_PRT2_PC2
LCD_Char_LCDPort__2__PORT EQU 2
LCD_Char_LCDPort__2__SHIFT EQU 2
LCD_Char_LCDPort__3__MASK EQU 0x08
LCD_Char_LCDPort__3__PC EQU CYREG_PRT2_PC3
LCD_Char_LCDPort__3__PORT EQU 2
LCD_Char_LCDPort__3__SHIFT EQU 3
LCD_Char_LCDPort__4__MASK EQU 0x10
LCD_Char_LCDPort__4__PC EQU CYREG_PRT2_PC4
LCD_Char_LCDPort__4__PORT EQU 2
LCD_Char_LCDPort__4__SHIFT EQU 4
LCD_Char_LCDPort__5__MASK EQU 0x20
LCD_Char_LCDPort__5__PC EQU CYREG_PRT2_PC5
LCD_Char_LCDPort__5__PORT EQU 2
LCD_Char_LCDPort__5__SHIFT EQU 5
LCD_Char_LCDPort__6__MASK EQU 0x40
LCD_Char_LCDPort__6__PC EQU CYREG_PRT2_PC6
LCD_Char_LCDPort__6__PORT EQU 2
LCD_Char_LCDPort__6__SHIFT EQU 6
LCD_Char_LCDPort__AG EQU CYREG_PRT2_AG
LCD_Char_LCDPort__AMUX EQU CYREG_PRT2_AMUX
LCD_Char_LCDPort__BIE EQU CYREG_PRT2_BIE
LCD_Char_LCDPort__BIT_MASK EQU CYREG_PRT2_BIT_MASK
LCD_Char_LCDPort__BYP EQU CYREG_PRT2_BYP
LCD_Char_LCDPort__CTL EQU CYREG_PRT2_CTL
LCD_Char_LCDPort__DM0 EQU CYREG_PRT2_DM0
LCD_Char_LCDPort__DM1 EQU CYREG_PRT2_DM1
LCD_Char_LCDPort__DM2 EQU CYREG_PRT2_DM2
LCD_Char_LCDPort__DR EQU CYREG_PRT2_DR
LCD_Char_LCDPort__INP_DIS EQU CYREG_PRT2_INP_DIS
LCD_Char_LCDPort__LCD_COM_SEG EQU CYREG_PRT2_LCD_COM_SEG
LCD_Char_LCDPort__LCD_EN EQU CYREG_PRT2_LCD_EN
LCD_Char_LCDPort__MASK EQU 0x7F
LCD_Char_LCDPort__PORT EQU 2
LCD_Char_LCDPort__PRT EQU CYREG_PRT2_PRT
LCD_Char_LCDPort__PRTDSI__CAPS_SEL EQU CYREG_PRT2_CAPS_SEL
LCD_Char_LCDPort__PRTDSI__DBL_SYNC_IN EQU CYREG_PRT2_DBL_SYNC_IN
LCD_Char_LCDPort__PRTDSI__OE_SEL0 EQU CYREG_PRT2_OE_SEL0
LCD_Char_LCDPort__PRTDSI__OE_SEL1 EQU CYREG_PRT2_OE_SEL1
LCD_Char_LCDPort__PRTDSI__OUT_SEL0 EQU CYREG_PRT2_OUT_SEL0
LCD_Char_LCDPort__PRTDSI__OUT_SEL1 EQU CYREG_PRT2_OUT_SEL1
LCD_Char_LCDPort__PRTDSI__SYNC_OUT EQU CYREG_PRT2_SYNC_OUT
LCD_Char_LCDPort__PS EQU CYREG_PRT2_PS
LCD_Char_LCDPort__SHIFT EQU 0
LCD_Char_LCDPort__SLW EQU CYREG_PRT2_SLW

; Pin_Sonido
Pin_Sonido__0__MASK EQU 0x80
Pin_Sonido__0__PC EQU CYREG_PRT0_PC7
Pin_Sonido__0__PORT EQU 0
Pin_Sonido__0__SHIFT EQU 7
Pin_Sonido__AG EQU CYREG_PRT0_AG
Pin_Sonido__AMUX EQU CYREG_PRT0_AMUX
Pin_Sonido__BIE EQU CYREG_PRT0_BIE
Pin_Sonido__BIT_MASK EQU CYREG_PRT0_BIT_MASK
Pin_Sonido__BYP EQU CYREG_PRT0_BYP
Pin_Sonido__CTL EQU CYREG_PRT0_CTL
Pin_Sonido__DM0 EQU CYREG_PRT0_DM0
Pin_Sonido__DM1 EQU CYREG_PRT0_DM1
Pin_Sonido__DM2 EQU CYREG_PRT0_DM2
Pin_Sonido__DR EQU CYREG_PRT0_DR
Pin_Sonido__INP_DIS EQU CYREG_PRT0_INP_DIS
Pin_Sonido__LCD_COM_SEG EQU CYREG_PRT0_LCD_COM_SEG
Pin_Sonido__LCD_EN EQU CYREG_PRT0_LCD_EN
Pin_Sonido__MASK EQU 0x80
Pin_Sonido__PORT EQU 0
Pin_Sonido__PRT EQU CYREG_PRT0_PRT
Pin_Sonido__PRTDSI__CAPS_SEL EQU CYREG_PRT0_CAPS_SEL
Pin_Sonido__PRTDSI__DBL_SYNC_IN EQU CYREG_PRT0_DBL_SYNC_IN
Pin_Sonido__PRTDSI__OE_SEL0 EQU CYREG_PRT0_OE_SEL0
Pin_Sonido__PRTDSI__OE_SEL1 EQU CYREG_PRT0_OE_SEL1
Pin_Sonido__PRTDSI__OUT_SEL0 EQU CYREG_PRT0_OUT_SEL0
Pin_Sonido__PRTDSI__OUT_SEL1 EQU CYREG_PRT0_OUT_SEL1
Pin_Sonido__PRTDSI__SYNC_OUT EQU CYREG_PRT0_SYNC_OUT
Pin_Sonido__PS EQU CYREG_PRT0_PS
Pin_Sonido__SHIFT EQU 7
Pin_Sonido__SLW EQU CYREG_PRT0_SLW

; Pin_Play_Pause
Pin_Play_Pause__0__MASK EQU 0x40
Pin_Play_Pause__0__PC EQU CYREG_PRT1_PC6
Pin_Play_Pause__0__PORT EQU 1
Pin_Play_Pause__0__SHIFT EQU 6
Pin_Play_Pause__AG EQU CYREG_PRT1_AG
Pin_Play_Pause__AMUX EQU CYREG_PRT1_AMUX
Pin_Play_Pause__BIE EQU CYREG_PRT1_BIE
Pin_Play_Pause__BIT_MASK EQU CYREG_PRT1_BIT_MASK
Pin_Play_Pause__BYP EQU CYREG_PRT1_BYP
Pin_Play_Pause__CTL EQU CYREG_PRT1_CTL
Pin_Play_Pause__DM0 EQU CYREG_PRT1_DM0
Pin_Play_Pause__DM1 EQU CYREG_PRT1_DM1
Pin_Play_Pause__DM2 EQU CYREG_PRT1_DM2
Pin_Play_Pause__DR EQU CYREG_PRT1_DR
Pin_Play_Pause__INP_DIS EQU CYREG_PRT1_INP_DIS
Pin_Play_Pause__LCD_COM_SEG EQU CYREG_PRT1_LCD_COM_SEG
Pin_Play_Pause__LCD_EN EQU CYREG_PRT1_LCD_EN
Pin_Play_Pause__MASK EQU 0x40
Pin_Play_Pause__PORT EQU 1
Pin_Play_Pause__PRT EQU CYREG_PRT1_PRT
Pin_Play_Pause__PRTDSI__CAPS_SEL EQU CYREG_PRT1_CAPS_SEL
Pin_Play_Pause__PRTDSI__DBL_SYNC_IN EQU CYREG_PRT1_DBL_SYNC_IN
Pin_Play_Pause__PRTDSI__OE_SEL0 EQU CYREG_PRT1_OE_SEL0
Pin_Play_Pause__PRTDSI__OE_SEL1 EQU CYREG_PRT1_OE_SEL1
Pin_Play_Pause__PRTDSI__OUT_SEL0 EQU CYREG_PRT1_OUT_SEL0
Pin_Play_Pause__PRTDSI__OUT_SEL1 EQU CYREG_PRT1_OUT_SEL1
Pin_Play_Pause__PRTDSI__SYNC_OUT EQU CYREG_PRT1_SYNC_OUT
Pin_Play_Pause__PS EQU CYREG_PRT1_PS
Pin_Play_Pause__SHIFT EQU 6
Pin_Play_Pause__SLW EQU CYREG_PRT1_SLW

; Miscellaneous
BCLK__BUS_CLK__HZ EQU 24000000
BCLK__BUS_CLK__KHZ EQU 24000
BCLK__BUS_CLK__MHZ EQU 24
CYDEV_CHIP_DIE_LEOPARD EQU 1
CYDEV_CHIP_DIE_PANTHER EQU 4
CYDEV_CHIP_DIE_PSOC4A EQU 2
CYDEV_CHIP_DIE_PSOC5LP EQU 5
CYDEV_CHIP_DIE_UNKNOWN EQU 0
CYDEV_CHIP_FAMILY_PSOC3 EQU 1
CYDEV_CHIP_FAMILY_PSOC4 EQU 2
CYDEV_CHIP_FAMILY_PSOC5 EQU 3
CYDEV_CHIP_FAMILY_UNKNOWN EQU 0
CYDEV_CHIP_FAMILY_USED EQU CYDEV_CHIP_FAMILY_PSOC5
CYDEV_CHIP_JTAG_ID EQU 0x2E123069
CYDEV_CHIP_MEMBER_3A EQU 1
CYDEV_CHIP_MEMBER_4A EQU 2
CYDEV_CHIP_MEMBER_4D EQU 3
CYDEV_CHIP_MEMBER_5A EQU 4
CYDEV_CHIP_MEMBER_5B EQU 5
CYDEV_CHIP_MEMBER_UNKNOWN EQU 0
CYDEV_CHIP_MEMBER_USED EQU CYDEV_CHIP_MEMBER_5B
CYDEV_CHIP_DIE_EXPECT EQU CYDEV_CHIP_MEMBER_USED
CYDEV_CHIP_DIE_ACTUAL EQU CYDEV_CHIP_DIE_EXPECT
CYDEV_CHIP_REV_LEOPARD_ES1 EQU 0
CYDEV_CHIP_REV_LEOPARD_ES2 EQU 1
CYDEV_CHIP_REV_LEOPARD_ES3 EQU 3
CYDEV_CHIP_REV_LEOPARD_PRODUCTION EQU 3
CYDEV_CHIP_REV_PANTHER_ES0 EQU 0
CYDEV_CHIP_REV_PANTHER_ES1 EQU 1
CYDEV_CHIP_REV_PANTHER_PRODUCTION EQU 1
CYDEV_CHIP_REV_PSOC4A_ES0 EQU 17
CYDEV_CHIP_REV_PSOC4A_PRODUCTION EQU 17
CYDEV_CHIP_REV_PSOC5LP_ES0 EQU 0
CYDEV_CHIP_REV_PSOC5LP_PRODUCTION EQU 0
CYDEV_CHIP_REVISION_3A_ES1 EQU 0
CYDEV_CHIP_REVISION_3A_ES2 EQU 1
CYDEV_CHIP_REVISION_3A_ES3 EQU 3
CYDEV_CHIP_REVISION_3A_PRODUCTION EQU 3
CYDEV_CHIP_REVISION_4A_ES0 EQU 17
CYDEV_CHIP_REVISION_4A_PRODUCTION EQU 17
CYDEV_CHIP_REVISION_4D_ES0 EQU 0
CYDEV_CHIP_REVISION_4D_PRODUCTION EQU 0
CYDEV_CHIP_REVISION_5A_ES0 EQU 0
CYDEV_CHIP_REVISION_5A_ES1 EQU 1
CYDEV_CHIP_REVISION_5A_PRODUCTION EQU 1
CYDEV_CHIP_REVISION_5B_ES0 EQU 0
CYDEV_CHIP_REVISION_5B_PRODUCTION EQU 0
CYDEV_CHIP_REVISION_USED EQU CYDEV_CHIP_REVISION_5B_PRODUCTION
CYDEV_CHIP_REV_EXPECT EQU CYDEV_CHIP_REVISION_USED
CYDEV_CONFIG_FASTBOOT_ENABLED EQU 1
CYDEV_CONFIG_UNUSED_IO_AllowButWarn EQU 0
CYDEV_CONFIG_UNUSED_IO EQU CYDEV_CONFIG_UNUSED_IO_AllowButWarn
CYDEV_CONFIG_UNUSED_IO_AllowWithInfo EQU 1
CYDEV_CONFIG_UNUSED_IO_Disallowed EQU 2
CYDEV_CONFIGURATION_COMPRESSED EQU 1
CYDEV_CONFIGURATION_DMA EQU 0
CYDEV_CONFIGURATION_ECC EQU 1
CYDEV_CONFIGURATION_IMOENABLED EQU CYDEV_CONFIG_FASTBOOT_ENABLED
CYDEV_CONFIGURATION_MODE_COMPRESSED EQU 0
CYDEV_CONFIGURATION_MODE EQU CYDEV_CONFIGURATION_MODE_COMPRESSED
CYDEV_CONFIGURATION_MODE_DMA EQU 2
CYDEV_CONFIGURATION_MODE_UNCOMPRESSED EQU 1
CYDEV_DEBUG_ENABLE_MASK EQU 0x20
CYDEV_DEBUG_ENABLE_REGISTER EQU CYREG_MLOGIC_DEBUG
CYDEV_DEBUGGING_DPS_Disable EQU 3
CYDEV_DEBUGGING_DPS_JTAG_4 EQU 1
CYDEV_DEBUGGING_DPS_JTAG_5 EQU 0
CYDEV_DEBUGGING_DPS_SWD EQU 2
CYDEV_DEBUGGING_DPS_SWD_SWV EQU 6
CYDEV_DEBUGGING_DPS EQU CYDEV_DEBUGGING_DPS_SWD_SWV
CYDEV_DEBUGGING_ENABLE EQU 1
CYDEV_DEBUGGING_XRES EQU 0
CYDEV_DMA_CHANNELS_AVAILABLE EQU 24
CYDEV_ECC_ENABLE EQU 0
CYDEV_HEAP_SIZE EQU 0x1000
CYDEV_INSTRUCT_CACHE_ENABLED EQU 1
CYDEV_INTR_RISING EQU 0x00000001
CYDEV_PROJ_TYPE EQU 0
CYDEV_PROJ_TYPE_BOOTLOADER EQU 1
CYDEV_PROJ_TYPE_LOADABLE EQU 2
CYDEV_PROJ_TYPE_MULTIAPPBOOTLOADER EQU 3
CYDEV_PROJ_TYPE_STANDARD EQU 0
CYDEV_PROTECTION_ENABLE EQU 0
CYDEV_STACK_SIZE EQU 0x4000
CYDEV_USE_BUNDLED_CMSIS EQU 1
CYDEV_VARIABLE_VDDA EQU 0
CYDEV_VDDA_MV EQU 5000
CYDEV_VDDD_MV EQU 5000
CYDEV_VDDIO0_MV EQU 5000
CYDEV_VDDIO1_MV EQU 5000
CYDEV_VDDIO2_MV EQU 5000
CYDEV_VDDIO3_MV EQU 5000
CYDEV_VIO0 EQU 5
CYDEV_VIO0_MV EQU 5000
CYDEV_VIO1 EQU 5
CYDEV_VIO1_MV EQU 5000
CYDEV_VIO2 EQU 5
CYDEV_VIO2_MV EQU 5000
CYDEV_VIO3 EQU 5
CYDEV_VIO3_MV EQU 5000
CYIPBLOCK_ARM_CM3_VERSION EQU 0
CYIPBLOCK_P3_ANAIF_VERSION EQU 0
CYIPBLOCK_P3_CAN_VERSION EQU 0
CYIPBLOCK_P3_CAPSENSE_VERSION EQU 0
CYIPBLOCK_P3_COMP_VERSION EQU 0
CYIPBLOCK_P3_DECIMATOR_VERSION EQU 0
CYIPBLOCK_P3_DFB_VERSION EQU 0
CYIPBLOCK_P3_DMA_VERSION EQU 0
CYIPBLOCK_P3_DRQ_VERSION EQU 0
CYIPBLOCK_P3_DSM_VERSION EQU 0
CYIPBLOCK_P3_EMIF_VERSION EQU 0
CYIPBLOCK_P3_I2C_VERSION EQU 0
CYIPBLOCK_P3_LCD_VERSION EQU 0
CYIPBLOCK_P3_LPF_VERSION EQU 0
CYIPBLOCK_P3_OPAMP_VERSION EQU 0
CYIPBLOCK_P3_PM_VERSION EQU 0
CYIPBLOCK_P3_SCCT_VERSION EQU 0
CYIPBLOCK_P3_TIMER_VERSION EQU 0
CYIPBLOCK_P3_USB_VERSION EQU 0
CYIPBLOCK_P3_VIDAC_VERSION EQU 0
CYIPBLOCK_P3_VREF_VERSION EQU 0
CYIPBLOCK_S8_GPIO_VERSION EQU 0
CYIPBLOCK_S8_IRQ_VERSION EQU 0
CYIPBLOCK_S8_SAR_VERSION EQU 0
CYIPBLOCK_S8_SIO_VERSION EQU 0
CYIPBLOCK_S8_UDB_VERSION EQU 0
DMA_CHANNELS_USED__MASK0 EQU 0x00000000
CYDEV_BOOTLOADER_ENABLE EQU 0
    ENDIF
    END
